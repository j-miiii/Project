## sdkconfig.defaults
```kconfig
CONFIG_ULP_SHARED_MEM=0x400

# Watchdog fail-safe: auto reset on deadlock, 15s timeout
CONFIG_ESP_TASK_WDT_PANIC=y
CONFIG_ESP_TASK_WDT_TIMEOUT_S=15
CONFIG_TASK_WDT_PANIC=y
CONFIG_TASK_WDT_TIMEOUT_S=15
```
